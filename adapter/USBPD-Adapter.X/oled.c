#include "oled.h"
#include "sh1106_driver.h"
#include "util.h"
#include "ui.h"
#include <string.h>

//digits size 12pt - 0123456789- - pages 0-2
#define OLED_DIG12_CHARWIDTH 9
#define OLED_DIG12_TOTALWIDTH (OLED_DIG12_CHARWIDTH * 11)
static const uint8_t _oled_digits_12[] = {
    0x00, 0xe0, 0x10, 0x10, 0x10, 0x10, 0x10, 0xe0, 0x00, 0x00, 0x40,
    0x20, 0x20, 0xf0, 0x00, 0x00, 0x00, 0x00, 0x00, 0x60, 0x10, 0x10,
    0x10, 0x10, 0x10, 0xe0, 0x00, 0x00, 0x60, 0x10, 0x10, 0x10, 0x10,
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    0x00, 0x00, 0x00, 0x00, 0x00, 0x00, 0x00, 0x00, 0x00, 0x00, 0x00
};

//digits size 13pt - 0123456789- - pages 5-7
#define OLED_DIG13_CHARWIDTH 10
#define OLED_DIG13_TOTALWIDTH (OLED_DIG13_CHARWIDTH * 11)
static const uint8_t _oled_digits_13[] = {
    0x00, 0x80, 0x40, 0x20, 0x20, 0x20, 0x20, 0x40, 0x80, 0x00, 0x00,
    0x00, 0x80, 0x40, 0x20, 0xe0, 0x00, 0x00, 0x00, 0x00, 0x00, 0x80,
    0x40, 0x20, 0x20, 0x20, 0x20, 0x40, 0x80, 0x00, 0x00, 0x80, 0x40,
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    0x00, 0x00, 0x00, 0x00, 0x00, 0x00, 0x00, 0x00, 0x00, 0x00, 0x00
};

//labels - Fixed PPS CV CC ON XX Hourglass - pages 3-4
static const uint16_t _oled_labels_offsets[] = { 0, 39, 63, 79, 95, 110, 125 };
static const uint16_t _oled_labels_columns[] = { 8, 15, 94, 94, 58, 58, 60 };
static const uint16_t _oled_labels_widths[] = { 39, 24, 16, 16, 15, 15, 11 };
#define OLED_LABELS_TOTALWIDTH 136
static const uint8_t _oled_labels[] = {
    0x00, 0xfc, 0x84, 0x84, 0x84, 0x00, 0x00, 0x00, 0x20, 0x20, 0xe4, 0x00, 0x00, 0x00, 0x00, 0x00, 0x20,
    0xc0, 0x00, 0x80, 0x60, 0x00, 0x00, 0x00, 0xc0, 0x20, 0x20, 0x20, 0x20, 0xc0, 0x00, 0x00, 0xc0, 0x20,
    0x20, 0x20, 0xfc, 0x00, 0x00, 0x00, 0xfc, 0x84, 0x84, 0x84, 0x84, 0x78, 0x00, 0x00, 0xfc, 0x84, 0x84,
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    0x18, 0x06, 0x01, 0x02, 0x1c, 0x00, 0x00, 0x38, 0x34, 0x32, 0x31, 0x30, 0x31, 0x32, 0x34, 0x38, 0x00
};

//base background - all pages
static const uint8_t _oled_background[] = {
    0x00, 0x00, 0x00, 0x00, 0x00, 0x00, 0x00, 0x00, 0x00, 0x00, 0x00, 0x00, 0x00, 0x00, 0x00, 0x00,
    0x00, 0x00, 0x00, 0x00, 0x00, 0x00, 0x00, 0x00, 0x00, 0x00, 0x00, 0x00, 0x00, 0x00, 0x00, 0x00,
    0x00, 0x00, 0x00, 0x00, 0x00, 0x00, 0x00, 0x00, 0x00, 0x00, 0x00, 0x00, 0x00, 0x00, 0x00, 0x00,
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    0x00, 0x00, 0x00, 0x00, 0x0e, 0x01, 0x00, 0x00, 0x00, 0x00, 0x01, 0x0e, 0x00, 0x00, 0x00, 0x00
};


static void _oled_drawDigit12(uint8_t column, uint8_t index) {
    if (column >= 128 - OLED_DIG12_CHARWIDTH || index > 10) return;
    
    uint16_t writeOffset = column;
    uint16_t readOffset = index * OLED_DIG12_CHARWIDTH;
    
    uint16_t i, j;
    for (i = 0; i < 3; i++) {
        if (i < 2) {
            memcpy(sh_framebuf + writeOffset, _oled_digits_12 + readOffset, OLED_DIG12_CHARWIDTH);
        } else {
            for (j = 0; j < OLED_DIG12_CHARWIDTH; j++) {
                sh_framebuf[writeOffset + j] |= _oled_digits_12[readOffset + j];
            }
        }        
        writeOffset += 128;
        readOffset += OLED_DIG12_TOTALWIDTH;
    }
}

static void _oled_drawDigit13(uint8_t column, uint8_t index) {
    if (column >= 128 - OLED_DIG13_CHARWIDTH || index > 10) return;
    
    uint16_t writeOffset = 5 * 128 + column;
    uint16_t readOffset = index * OLED_DIG13_CHARWIDTH;
    
    uint16_t i, j;
    for (i = 0; i < 3; i++) {
        if (i > 0) {
            memcpy(sh_framebuf + writeOffset, _oled_digits_13 + readOffset, OLED_DIG13_CHARWIDTH);
        } else {
            for (j = 0; j < OLED_DIG13_CHARWIDTH; j++) {
                sh_framebuf[writeOffset + j] |= _oled_digits_13[readOffset + j];
            }
        }
        writeOffset += 128;
        readOffset += OLED_DIG13_TOTALWIDTH;
    }
}

static void _oled_drawLabel(uint8_t index) {
    if (index > 6) return;
    
    uint16_t writeOffset = 3 * 128 + _oled_labels_columns[index];
    uint16_t readOffset = _oled_labels_offsets[index];
    
    uint16_t i;
    for (i = 0; i < 2; i++) {
        memcpy(sh_framebuf + writeOffset, _oled_labels + readOffset, _oled_labels_widths[index]);
        writeOffset += 128;
        readOffset += OLED_LABELS_TOTALWIDTH;
    }
}

static void _oled_drawNumber(uint8_t endColumn, int32_t numTimes100, uint8_t digits, uint8_t digitWidth, void (*digitFunc)(uint8_t, uint8_t)) {
    if (endColumn > 128 || digits < 3 || digits > 4) return;
    
    uint8_t col = endColumn - digitWidth;
    uint16_t i;
    
    const int32_t limits[] = {1000, 10000};
    if (numTimes100 < 0 || numTimes100 >= limits[digits - 3]) { //dashes for invalid numbers
        digitFunc(col, 10);
        col -= digitWidth;
        digitFunc(col, 10);
        col -= 2 * digitWidth;
        for (i = 2; i < digits; i++) {
            digitFunc(col, 10);
            col -= digitWidth;
        }
    } else { //draw number itself
        digitFunc(col, numTimes100 % 10);
        col -= digitWidth;
        numTimes100 /= 10;
        digitFunc(col, numTimes100 % 10);
        col -= 2 * digitWidth;
        numTimes100 /= 10;
        for (i = 2; i < digits; i++) {
            digitFunc(col, numTimes100 % 10);
            col -= digitWidth;
            numTimes100 /= 10;
        }
    }
}

static void _oled_drawNumber12(uint8_t endColumn, int32_t numTimes100, uint8_t digits) {
    _oled_drawNumber(endColumn, numTimes100, digits, OLED_DIG12_CHARWIDTH, &_oled_drawDigit12);
}

static void _oled_drawNumber13(uint8_t endColumn, int32_t numTimes100, uint8_t digits) {
    _oled_drawNumber(endColumn, numTimes100, digits, OLED_DIG13_CHARWIDTH, &_oled_drawDigit13);
}

static void _oled_drawSelectBox(uint8_t startColumn, uint8_t endColumn) {
    sh_framebuf[startColumn] |= 0xFC;
    sh_framebuf[128 + startColumn] |= 0xFF;
    sh_framebuf[256 + startColumn] |= 0x0F;
    sh_framebuf[endColumn - 1] |= 0xFC;
    sh_framebuf[128 + endColumn - 1] |= 0xFF;
    sh_framebuf[256 + endColumn - 1] |= 0x0F;
    
    sh_framebuf[startColumn + 1] |= 0x04;
    sh_framebuf[startColumn + 2] |= 0x04;
    sh_framebuf[endColumn - 2] |= 0x04;
    sh_framebuf[endColumn - 3] |= 0x04;
    
    sh_framebuf[256 + startColumn + 1] |= 0x08;
    sh_framebuf[256 + startColumn + 2] |= 0x08;
    sh_framebuf[256 + endColumn - 2] |= 0x08;
    sh_framebuf[256 + endColumn - 3] |= 0x08;
}


bool OLED_UpdateScreen() {
    memcpy(sh_framebuf, _oled_background, SH_FRAMEBUF_SIZE);
    
    _oled_drawNumber12(48, ui_setVoltagex10mV, 4);
    _oled_drawNumber12(115, ui_setCurrentx10mA, 3);
    
    _oled_drawNumber13(53, ui_outVoltagex10mV, 4);
    _oled_drawNumber13(114, ui_outCurrentx10mA, 3);
    
    _oled_drawLabel(ui_pps ? 1 : 0);
    _oled_drawLabel(ui_cc ? 3 : 2);
    
    switch (ui_state) {
        case UI_ADJ_VOLTAGE:
            _oled_drawSelectBox(2, 59);
            break;
        case UI_ADJ_CURRENT:
            _oled_drawSelectBox(78, 126);
            break;
        case UI_ERROR:
            _oled_drawLabel(5);
            break;
        case UI_WAITING:
            _oled_drawLabel(6);
            break;
        case UI_OUTPUTTING:
            _oled_drawLabel(4);
            break;
        default:
            break;
    }
    
    return SH_WriteFramebuffer();
}

bool OLED_Initialize() {
    asserttrue(SH_Initialize());
    
    return OLED_UpdateScreen();
}
